
//----------------------------------------< Библиотека для работы с шиной I2C >-----------------------------------------------

//#define F_CPU 7372800UL

//=======================================================================
//					       Подключаемые файлы
//=======================================================================

#include <avr/io.h>
#include <util/delay.h>
#include <stdlib.h>
#include "i2c.h"

//=======================================================================
//					       Функция генерирующая условия стоп
//=======================================================================
uint8_t i2c_slave;
uint8_t for_i2c_data;
uint8_t ASK=0;
uint8_t i2c_chk=0;
uint8_t ttmp;
void i2c_stop(void)
	{
		uint8_t stop_byte=0;
		stop_byte|=(1<<TWINT) |(1<<TWEN)|(1<<TWSTO);
		TWCR = stop_byte;
	}
	
//=======================================================================
//					       Функция генерирующая условия старт
//=======================================================================
void i2c_start(void)
	{
	TWCR = (1<<TWINT)|(1<<TWSTA)|(1<<TWEN);
	}
	
//=======================================================================
//					       Функция генерирующая условия рестарт
//=======================================================================

void i2c_restart(void)
	{}
	
//=======================================================================
//					       Функция инициализации шины
//=======================================================================

void TWI_INIT(){
TWBR = ((F_CPU / TWI_FREQ) - 16) / 2; //Частота
}

void i2c_init(uint8_t address)
	{
		i2c_slave=address;
		ttmp=i2c_slave<<1;
		TWI_INIT();
	}
	
//=======================================================================
//					       Функция отправки байта по шине
//=======================================================================
uint8_t i2c_send_byte(uint8_t data)
	{
		for_i2c_data=data;
		DDRB|=(1<<5);
		PORTB&=~(1<<5);
		i2c_start();
		while(!(TWCR&(1<<TWINT)));
		TWDR = ttmp;
		TWCR = (1<<TWINT) |(1<<TWEN);
		while(!(TWCR&(1<<TWINT)));
		TWDR = for_i2c_data;
		TWCR = (1<<TWINT) |(1<<TWEN);
		while(!(TWCR&(1<<TWINT)));
		i2c_stop();
		//}
	return	ASK;
	}
	
//=======================================================================
//					       Функция чтения байта c шинs
//=======================================================================
